## LED_RGBv1/main/Kconfig.projbuild
```kconfig
menu "Example Configuration"

    config BROKER_URL
        string "Broker URL"
        default "mqtt://mqtt.eclipse.org"
        help
            URL of the broker to connect to

    config BROKER_URL_FROM_STDIN
        bool
        default y if BROKER_URL = "FROM_STDIN"

    config EXAMPLE_RMT_TX_GPIO
        int "RMT TX GPIO"
        default 18
        help
            Set the GPIO number used for transmitting the RMT signal.
    
    config EXAMPLE_STRIP_LED_NUMBER
        int "Number of LEDS in a strip"
        default 24
        help
            A single RGB strip contains several LEDs.

endmenu
```
